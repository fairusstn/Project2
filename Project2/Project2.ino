#include <WiFi.h>
#include <PubSubClient.h>
#include <Wire.h>
#include <Adafruit_GFX.h>
#include <Adafruit_SSD1306.h>
#include <Fonts/FreeSerif9pt7b.h>

#define SCREEN_WIDTH 128 // OLED display width, in pixels
#define SCREEN_HEIGHT 64 // OLED display height, in pixels

#define LEDQ1R 14
#define LEDQ2R 27
#define LEDQ3R 26
#define LEDQ4R 25

#define LEDQ1G 5    // Ca Yellow
#define LEDQ2G 18   // Ca White
#define LEDQ3G 19   // Ca RED
#define LEDQ4G 3    // Ca Green

#define Quarter1 34
#define Quarter2 35
#define Quarter3 32
#define Quarter4 33
#define Q1 0
#define Q2 1
#define Q3 2
#define Q4 3
#define VREF 5.0      // analog reference voltage(Volt) of the ADC
#define SCOUNT  30           // sum of sample point
int analogBuffer[4][SCOUNT];    // store the analog value in the array, read from ADC
int analogBufferTemp[4][SCOUNT];
int analogBufferIndex = 0,copyIndex = 0,j = 0;
float tdsValue = 0,temperature = 25;
int LEDG[4] = {LEDQ1G , LEDQ2G , LEDQ3G , LEDQ4G};
float Quarter[4][128];
float tempQ[4] = {0.0,0.0,0.0,0.0};
float averageVoltage[4] = {0,0,0,0};
int x=0;
Adafruit_SSD1306 display(SCREEN_WIDTH, SCREEN_HEIGHT, &Wire, -1);

//const char *SSID = "DowroongMansion";
//const char *PWD = "11223344";
const char *SSID = "Fairuz";
const char *PWD = "1212312121";
const char* mqttServer = "192.168.43.151";
const int mqttPort = 1883;

WiFiClient espClient;
PubSubClient client(espClient);

float Hmaw = 0.0;
float DEE[]={ 0.0016,0.0031,0.0047,0.0063,0.0078,0.0094,0.0109,0.0125,0.0141,0.0156,0.0172,0.0188,0.0203,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4.6870, };
char mqttdata[16];

void connectToWiFi() {
  display.clearDisplay();
  display.setTextSize(1);             
  display.setTextColor(WHITE);
  display.setCursor(15,20);
  display.println("Connectiog to ");
  display.setCursor(32,32);             
  display.println(SSID);
  display.display();
  WiFi.begin(SSID, PWD);
  uint8_t i = 0;
  bool y = 0;
  while (WiFi.status() != WL_CONNECTED) {
    if(y == 0){
      display.setTextSize(2);    
      display.setCursor(20+i,45);
      display.println("."); 
      display.display();
    }else{
      display.setTextSize(2);    
      display.setCursor(20+i,20);
      display.println("."); 
      display.display();
    }
    i+=10;
    if(i > 59){
      display.clearDisplay();
      i = 0;
      if(y == 0)
        y = 1;
      else
        y = 0;  
    }
    delay(500);
  }
  display.clearDisplay();
  display.setTextSize(1);             
  display.setTextColor(WHITE);
  display.setCursor(15,20);
  display.println("!Connected.!");
  display.display();
}

void setup(){
    Serial.begin(115200);
    pinMode(LEDQ1G,OUTPUT);
    pinMode(LEDQ2G,OUTPUT);
    pinMode(LEDQ3G,OUTPUT);
    pinMode(LEDQ4G,OUTPUT);
    digitalWrite(LEDQ1G,HIGH);
    digitalWrite(LEDQ2G,HIGH);
    digitalWrite(LEDQ3G,HIGH);
    digitalWrite(LEDQ4G,HIGH);
    if(!display.begin(SSD1306_SWITCHCAPVCC, 0x3C)) { 
      for(;;);
    }
    connectToWiFi();
    display.clearDisplay();
    display.setTextSize(1);             
    display.setTextColor(WHITE);
    display.setCursor(15,32);             
    display.println("MQTT Server:");
    display.setCursor(30,45);
    display.println(mqttServer);    
    display.display();
    delay(500);
    client.setServer(mqttServer, mqttPort);
    while (!client.connected()) {
      display.clearDisplay();
      display.setCursor(15,32);             
      display.println("Connecting to MQTT...");
      display.display();
      delay(500);
      if (client.connect("ESP32Client")) {
        display.clearDisplay();
        display.setCursor(15,32);             
        display.println("Connected!!!");
        display.display();
        delay(500);
      } else {
        display.clearDisplay();
        display.setCursor(15,32);             
        display.println("failed with state");
        display.display();
        delay(2000);
      }
    }  
  client.publish("test/tds/1", "Hello from ESP32");

  delay(2000);
  display.setFont(&FreeSerif9pt7b);
  display.clearDisplay();
  display.setTextSize(1);             
  display.setTextColor(WHITE);
  display.setCursor(15,32);             
  display.println("Project Begin");
  display.display();
  delay(2000);
}

void loop(){
  static unsigned long analogSampleTimepoint = millis();
   if(millis()-analogSampleTimepoint > 40U){    //every 40 milliseconds,read the analog value from the ADC
     analogSampleTimepoint = millis();
     analogBuffer[Q1][analogBufferIndex] = analogRead(Quarter1);    //read the analog value and store into the buffer
     analogBuffer[Q2][analogBufferIndex] = analogRead(Quarter2);    //read the analog value and store into the buffer
     analogBuffer[Q3][analogBufferIndex] = analogRead(Quarter3);    //read the analog value and store into the buffer
     analogBuffer[Q4][analogBufferIndex] = analogRead(Quarter4);    //read the analog value and store into the buffer
     analogBufferIndex++;
     if(analogBufferIndex == SCOUNT) 
         analogBufferIndex = 0;
   }
   static unsigned long printTimepoint = millis();
   if(millis()-printTimepoint > 800U){
      printTimepoint = millis();
      for(copyIndex=0;copyIndex<SCOUNT;copyIndex++){
        analogBufferTemp[Q1][copyIndex]= analogBuffer[Q1][copyIndex];
        analogBufferTemp[Q2][copyIndex]= analogBuffer[Q2][copyIndex];
        analogBufferTemp[Q3][copyIndex]= analogBuffer[Q3][copyIndex];
        analogBufferTemp[Q4][copyIndex]= analogBuffer[Q4][copyIndex];
      }
      averageVoltage[Q1] = getMedianNum(analogBufferTemp[Q1],SCOUNT) * (float)VREF / 1024.0; // read the analog value more stable by the median filtering algorithm, and convert to voltage value
      averageVoltage[Q2] = getMedianNum(analogBufferTemp[Q2],SCOUNT) * (float)VREF / 1024.0;
      averageVoltage[Q3] = getMedianNum(analogBufferTemp[Q3],SCOUNT) * (float)VREF / 1024.0;
      averageVoltage[Q4] = getMedianNum(analogBufferTemp[Q4],SCOUNT) * (float)VREF / 1024.0;
      
      float compensationCoefficient=1.0+0.02*(37-25.0);    //temperature compensation formula: fFinalResult(37^C) = fFinalResult(current)/(1.0+0.02*(fTP-25.0));
      float compensationVolatgeQ1=averageVoltage[Q1]/compensationCoefficient;  //temperature compensation
      float compensationVolatgeQ2=averageVoltage[Q2]/compensationCoefficient;  
      float compensationVolatgeQ3=averageVoltage[Q3]/compensationCoefficient;  
      float compensationVolatgeQ4=averageVoltage[Q4]/compensationCoefficient;  
      
      Quarter[Q1][j]=(133.42*compensationVolatgeQ1*compensationVolatgeQ1*compensationVolatgeQ1 - 255.86*compensationVolatgeQ1*compensationVolatgeQ1 + 857.39*compensationVolatgeQ1)*0.5; //convert voltage value to tds value
      Quarter[Q2][j]=(133.42*compensationVolatgeQ2*compensationVolatgeQ2*compensationVolatgeQ2 - 255.86*compensationVolatgeQ2*compensationVolatgeQ2 + 857.39*compensationVolatgeQ2)*0.5;
      Quarter[Q3][j]=(133.42*compensationVolatgeQ3*compensationVolatgeQ3*compensationVolatgeQ3 - 255.86*compensationVolatgeQ3*compensationVolatgeQ3 + 857.39*compensationVolatgeQ3)*0.5;
      Quarter[Q4][j]=(133.42*compensationVolatgeQ4*compensationVolatgeQ4*compensationVolatgeQ4 - 255.86*compensationVolatgeQ4*compensationVolatgeQ4 + 857.39*compensationVolatgeQ4)*0.5;
      Quarter[Q1][j] = DEE[int(Quarter[Q1][j])];
      Quarter[Q2][j] = DEE[int(Quarter[Q2][j])];
      Quarter[Q3][j] = DEE[int(Quarter[Q3][j])];
      Quarter[Q4][j] = DEE[int(Quarter[Q4][j])];

      if(j%14 == 0 && j != 0){
        for(int i = 0;i<4;i++)
          tempQ[i] = 0.0;
        for(int i = 0;i<4;i++)
          for(int k = 0;k<j;k++)
            tempQ[i] += Quarter[i][k];
        for(int i = 0;i<4;i++)
          for(int k = 0;k<j;k++)
            tempQ[i] -= Quarter[i][j];
        for(int i = 0;i<4;i++){
          if(tempQ[i] < 0){
            tempQ[i] *= -1;
          }
        }
        for(int i = 0;i<4;i++){
          if(tempQ[i] > 2.0){
            sprintf(mqttdata, "Quarter %d is Mastitis.", i+1);
            client.publish("test/tds/result", mqttdata);
            digitalWrite(LEDG[i],LOW);
          }
          if(tempQ[i] <= 2.0)
            digitalWrite(LEDG[i],HIGH);
        }
        j = 0;
      }
      display.clearDisplay();
      display.setTextSize(1);             
      display.setTextColor(WHITE);
      display.setCursor(0,0);             
      display.print("Quarter 1 EC:");
      display.setTextSize(1);             
      display.setTextColor(WHITE);
      if(Quarter[Q1][0]> 4.5)
        display.print(">4.6870");
      else if(Quarter[Q1][j]<0.0017)
        display.print("<0.0016");
      else
        display.print(Quarter[Q1][j]);
      display.println(" mS");
      
      display.setCursor(20,0);             
      display.print("Quarter 1 EC:");
      display.setTextSize(1);             
      display.setTextColor(WHITE);
      if(Quarter[Q1][0]> 4.5)
        display.print(">4.6870");
      else if(Quarter[Q1][j]<0.0017)
        display.print("<0.0016");
      else
        display.print(Quarter[Q1][j]);
      display.println(" mS");
      
      display.setCursor(35,0);             
      display.print("Quarter 2 EC:");
      display.setTextSize(1);             
      display.setTextColor(WHITE);
      if(Quarter[Q1][0]> 4.5)
        display.print(">4.6870");
      else if(Quarter[Q1][j]<0.0017)
        display.print("<0.0016");
      else
        display.print(Quarter[Q1][j]);
      display.println(" mS");
      display.setCursor(45,0);             
      display.print("Quarter 1 EC:");
      display.setTextSize(1);             
      display.setTextColor(WHITE);
      if(Quarter[Q1][0]> 4.5)
        display.print(">4.6870");
      else if(Quarter[Q1][j]<0.0017)
        display.print("<0.0016");
      else
        display.print(Quarter[Q1][j]);
      display.println(" mS");
      display.display();

      sprintf(mqttdata, "%f", Quarter[Q1][j]);
      client.publish("test/tds/1", mqttdata);
      sprintf(mqttdata, "%f", Quarter[Q2][j]);
      client.publish("test/tds/2", mqttdata);
      sprintf(mqttdata, "%f", Quarter[Q3][j]);
      client.publish("test/tds/3", mqttdata);
      sprintf(mqttdata, "%f", Quarter[Q4][j]);
      client.publish("test/tds/4", mqttdata);
      j++;
   }
}
int getMedianNum(int bArray[], int iFilterLen){
  int bTab[iFilterLen];
  for (byte i = 0; i<iFilterLen; i++)
    bTab[i] = bArray[i];
  int i, j, bTemp;
  for (j = 0; j < iFilterLen - 1; j++){
    for (i = 0; i < iFilterLen - j - 1; i++){
      if (bTab[i] > bTab[i + 1]){
        bTemp = bTab[i];
        bTab[i] = bTab[i + 1];
        bTab[i + 1] = bTemp;
      }
    }
  }
  if ((iFilterLen & 1) > 0)
    bTemp = bTab[(iFilterLen - 1) / 2];
  else
    bTemp = (bTab[iFilterLen / 2] + bTab[iFilterLen / 2 - 1]) / 2;
  return bTemp;
}
